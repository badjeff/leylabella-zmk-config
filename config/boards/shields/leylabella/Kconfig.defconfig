## config/boards/shields/leylabella/Kconfig.defconfig
```kconfig
if SHIELD_LEYLABELLA_M1 || SHIELD_LEYLABELLA_M2

config ZMK_KEYBOARD_NAME
	default "leylabella"

endif
```

## config/boards/shields/leylabella/Kconfig.shield
```kconfig
# Copyright (c) 2020 Pete Johanson
# SPDX-License-Identifier: MIT

config SHIELD_LEYLABELLA_M1
	def_bool $(shields_list_contains,leylabella_m1)

config SHIELD_LEYLABELLA_M2
	def_bool $(shields_list_contains,leylabella_m2)
```

## config/west.yml
```yaml
manifest:
  remotes:
    - name: zmkfirmware
      url-base: https://github.com/zmkfirmware
    - name: badjeff
      url-base: https://github.com/badjeff
  projects:
    # - name: zmk
    #   remote: zmkfirmware
    #   revision: main
    #   import: app/west.yml
    - name: zmk
      remote: badjeff
      revision: main
      import: app/west.yml
    - name: zmk-paw3395-driver
      remote: badjeff
      revision: main
    - name: zmk-pmw3610-driver
      remote: badjeff
      revision: main
    - name: zmk-input-processor-report-rate-limit
      remote: badjeff
      revision: main
    - name: zmk-behavior-mouse-key-toggle
      remote: badjeff
      revision: main
  self:
    path: config
```
